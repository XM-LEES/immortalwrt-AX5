// SPDX-License-Identifier: GPL-2.0-or-later OR MIT

/dts-v1/;

#include "ipq6000-xiaomi-nowifi.dtsi"

/ {
	model = "Redmi AX5";
	compatible = "redmi,ax5", "qcom,ipq6018";
};

&wifi {
	status = "disabled";
};
